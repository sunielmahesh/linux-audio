## drivers/switch/Kconfig
```kconfig
# SPDX-License-Identifier: GPL-2.0
menuconfig SWITCH
	tristate "Switch class support"
	help
	  Say Y here to enable switch class support. This allows
	  monitoring switches by userspace via sysfs and uevent.
```
